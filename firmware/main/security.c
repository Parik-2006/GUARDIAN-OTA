/**
 * security.c — Cryptographic verification for OTA firmware updates.
 *
 * Implements:
 *  1. verify_sha256()           — mbedTLS SHA-256 digest comparison
 *  2. verify_ecc_signature()    — mbedTLS ECDSA-P256 pk_verify
 *  3. is_nonce_fresh()          — replay-attack prevention (timestamp + seen-nonce cache)
 *
 * The ECC public key is embedded at compile time. Replace the placeholder PEM
 * with the actual P-256 public key generated by your signing tool:
 *
 *   openssl ecparam -name prime256v1 -genkey -noout -out ota-key.pem
 *   openssl ec -in ota-key.pem -pubout -out ota-pubkey.pem
 */

#include "security.h"

#include <string.h>
#include <time.h>

#include "esp_log.h"
#include "mbedtls/base64.h"
#include "mbedtls/md.h"
#include "mbedtls/pk.h"

static const char *TAG = "security";

/* ── Embedded P-256 public key ──────────────────────────────────────────── */
/* Replaced with actual generated public key for OTA tests ─ */
static const char *OTA_PUBKEY_PEM =
    "-----BEGIN PUBLIC KEY-----\n"
    "MFkwEwYHKoZIzj0CAQYIKoZIzj0DAQcDQgAELh9jkWx+HDYurlgFrTW3vnXMCl5j\n"
    "PNL8HIk91t6le/INOfRjO+I45wBrDH8WjfA+rLvin2auVckQZaa8z4fH7w==\n"
    "-----END PUBLIC KEY-----\n";

/* ── Nonce cache (recent 32 nonces to detect replays) ───────────────────── */
#define NONCE_CACHE_SIZE 32
static char s_seen_nonces[NONCE_CACHE_SIZE][48];
static int  s_nonce_head = 0;

static bool nonce_is_duplicate(const char *nonce) {
    for (int i = 0; i < NONCE_CACHE_SIZE; i++) {
        if (strncmp(s_seen_nonces[i], nonce, 47) == 0) {
            return true;
        }
    }
    return false;
}

static void nonce_record(const char *nonce) {
    strncpy(s_seen_nonces[s_nonce_head], nonce, 47);
    s_seen_nonces[s_nonce_head][47] = '\0';
    s_nonce_head = (s_nonce_head + 1) % NONCE_CACHE_SIZE;
}

/* ── verify_sha256 ──────────────────────────────────────────────────────── */
bool verify_sha256(const uint8_t *image, size_t len, const char *expected_hex) {
    if (!image || !expected_hex || strlen(expected_hex) != 64) {
        return false;
    }

    uint8_t digest[32];
    mbedtls_md_context_t ctx;
    mbedtls_md_init(&ctx);

    const mbedtls_md_info_t *info = mbedtls_md_info_from_type(MBEDTLS_MD_SHA256);
    if (mbedtls_md_setup(&ctx, info, 0) != 0 ||
        mbedtls_md_starts(&ctx)            != 0 ||
        mbedtls_md_update(&ctx, image, len)!= 0 ||
        mbedtls_md_finish(&ctx, digest)    != 0) {
        mbedtls_md_free(&ctx);
        ESP_LOGE(TAG, "SHA-256 computation failed");
        return false;
    }
    mbedtls_md_free(&ctx);

    /* Convert digest to lowercase hex and compare */
    char computed_hex[65];
    for (int i = 0; i < 32; i++) {
        snprintf(computed_hex + (i * 2), 3, "%02x", digest[i]);
    }

    bool ok = (strncmp(computed_hex, expected_hex, 64) == 0);
    if (!ok) {
        ESP_LOGE(TAG, "SHA-256 MISMATCH: got %.16s... expected %.16s...", computed_hex, expected_hex);
    }
    return ok;
}

/* ── verify_ecc_signature ───────────────────────────────────────────────── */
bool verify_ecc_signature(const uint8_t hash32[32], const char *signature_b64) {
    if (!hash32 || !signature_b64) return false;

    /* Base64-decode the DER-encoded ECDSA signature */
    uint8_t sig_der[128];
    size_t  sig_der_len = 0;
    if (mbedtls_base64_decode(sig_der, sizeof(sig_der), &sig_der_len,
                              (const uint8_t *)signature_b64,
                              strlen(signature_b64)) != 0) {
        ESP_LOGE(TAG, "signature base64 decode failed");
        return false;
    }

    /* Parse the embedded public key */
    mbedtls_pk_context pk;
    mbedtls_pk_init(&pk);
    int rc = mbedtls_pk_parse_public_key(
        &pk,
        (const uint8_t *)OTA_PUBKEY_PEM,
        strlen(OTA_PUBKEY_PEM) + 1   /* include null terminator */
    );
    if (rc != 0) {
        mbedtls_pk_free(&pk);
        ESP_LOGE(TAG, "public key parse failed: -0x%X", (unsigned)(-rc));
        return false;
    }

    /* Verify the ECDSA signature */
    rc = mbedtls_pk_verify(&pk, MBEDTLS_MD_SHA256, hash32, 32, sig_der, sig_der_len);
    mbedtls_pk_free(&pk);

    if (rc != 0) {
        ESP_LOGE(TAG, "ECC signature INVALID: -0x%X", (unsigned)(-rc));
        return false;
    }
    ESP_LOGI(TAG, "ECC signature valid");
    return true;
}

/* ── is_nonce_fresh ─────────────────────────────────────────────────────── */
/*
 * parse_rfc3339_utc — Convert "YYYY-MM-DDTHH:MM:SSZ" to a UTC Unix timestamp
 * WITHOUT calling mktime(), which would apply the local timezone offset.
 *
 * We compute the epoch manually:
 *   1. Days from 1970-01-01 to the given date  (using the standard leap-year formula)
 *   2. + seconds into that day from HH:MM:SS
 *
 * Returns 0 on parse error.
 */
static time_t parse_rfc3339_utc(const char *s) {
    if (!s || strlen(s) < 20) return 0;

    int Y, M, D, h, m, sec;
    if (sscanf(s, "%4d-%2d-%2dT%2d:%2d:%2d",
               &Y, &M, &D, &h, &m, &sec) != 6) {
        return 0;
    }

    /* Days from epoch (1970-01-01) to 1st Jan of year Y.
     * Formula: Y*365 + leap-years-before-Y — same value at Y=1970 is the constant to subtract.
     * Constant = 1970*365 + 1969/4 - 1969/100 + 1969/400 = 719527                             */
    int y = Y - 1;
    long days = (long)Y * 365 + y / 4 - y / 100 + y / 400
              - (1970 * 365 + 1969 / 4 - 1969 / 100 + 1969 / 400);

    /* Add days for each month in this year (1-indexed) */
    static const int mdays[13] = {0,31,28,31,30,31,30,31,31,30,31,30,31};
    for (int i = 1; i < M; i++) {
        days += mdays[i];
        /* Leap-year correction for February */
        if (i == 2 && ((Y % 4 == 0 && Y % 100 != 0) || Y % 400 == 0)) {
            days += 1;
        }
    }
    days += D - 1;

    return (time_t)(days * 86400L + h * 3600 + m * 60 + sec);
}

bool is_nonce_fresh(const char *nonce, const char *issued_at_iso, int ttl_seconds) {
    if (!nonce || !issued_at_iso) return false;

    /* Replay check */
    if (nonce_is_duplicate(nonce)) {
        ESP_LOGW(TAG, "replay detected: nonce '%s' already seen", nonce);
        return false;
    }

    /* TTL check */
    time_t issued = parse_rfc3339_utc(issued_at_iso);
    time_t now    = time(NULL);

    /* If the RTC is clearly uninitialized (before year 2020), skip TTL.
     * An unsynchronized clock must never block a valid OTA command.
     * The nonce cache still prevents replay attacks. */
#define YEAR_2020_EPOCH 1577836800L
    if (now < YEAR_2020_EPOCH) {
        ESP_LOGW(TAG, "RTC not synced (now=%lld) — skipping TTL, accepting on nonce only",
                 (long long)now);
    } else if (issued == 0) {
        ESP_LOGW(TAG, "cannot parse issued_at: %s — skipping TTL check", issued_at_iso);
    } else {
        double age = difftime(now, issued);
        ESP_LOGI(TAG, "TTL check: now=%lld issued=%lld age=%.0fs ttl=%ds",
                 (long long)now, (long long)issued, age, ttl_seconds);
        if (age < -60 || age > (double)ttl_seconds) {
            ESP_LOGW(TAG, "OTA command expired: age=%.0fs TTL=%ds", age, ttl_seconds);
            return false;
        }
    }

    nonce_record(nonce);
    return true;
}

